## configs/soph_cv186ah_defconfig
```kconfig
BR2_aarch64=y
BR2_TOOLCHAIN_EXTERNAL=y
BR2_TOOLCHAIN_EXTERNAL_CUSTOM=y
BR2_TOOLCHAIN_EXTERNAL_PATH="$(TOOLCHAIN_PATH)/gcc/gcc-linaro-6.3.1-2017.05-x86_64_aarch64-linux-gnu"
BR2_TOOLCHAIN_EXTERNAL_CUSTOM_PREFIX="aarch64-linux-gnu"
BR2_TOOLCHAIN_EXTERNAL_GCC_6=y
BR2_TOOLCHAIN_EXTERNAL_HEADERS_4_6=y
BR2_TOOLCHAIN_EXTERNAL_CUSTOM_GLIBC=y
BR2_TOOLCHAIN_EXTERNAL_CXX=y
BR2_TOOLCHAIN_EXTERNAL_FORTRAN=y
BR2_TOOLCHAIN_EXTERNAL_OPENMP=y
BR2_BACKUP_SITE="http://sources.buildroot.net"
BR2_CPAN_MIRROR="http://cpan.metacpan.org"
BR2_GLOBAL_PATCH_DIR="$(BR2_OVERLAY_PATH)/common/patches $(BR2_OVERLAY_PATH)/cv186ah_wevb_emmc/patches"
BR2_TARGET_GENERIC_HOSTNAME="soph-cv186ah"
BR2_TARGET_GENERIC_ISSUE="Welcome to SOPH-CV186AH"
BR2_TARGET_GENERIC_ROOT_PASSWD="sophgo"
BR2_ROOTFS_OVERLAY="$(BR2_OVERLAY_PATH)/common/overlay $(BR2_OVERLAY_PATH)/cv186ah_wevb_emmc/overlay"
BR2_PACKAGE_E2FSPROGS=y
BR2_PACKAGE_E2FSPROGS_RESIZE2FS=y
BR2_PACKAGE_PARTED=y
BR2_PACKAGE_COLLECTD=y
BR2_PACKAGE_COLLECTD_NTPD=y
BR2_PACKAGE_NTP=y
# BR2_PACKAGE_URANDOM_SCRIPTS is not set
BR2_TARGET_ROOTFS_SQUASHFS=y
BR2_TARGET_ROOTFS_SQUASHFS4_XZ=y
# BR2_TARGET_ROOTFS_TAR is not set
BR2_PACKAGE_HOST_UTIL_LINUX=y
```

## package/sophgo/Config.in
```kconfig
config BR2_PACKAGE_SOPHGO
	bool "sophgo package"
	depends on BR2_INSTALL_LIBSTDCPP
	depends on BR2_TOOLCHAIN_USES_GLIBC
	depends on BR2_aarch64
	help
	  Install the package.

if BR2_PACKAGE_SOPHGO

config BR2_PACKAGE_SOPHGO_BMLIB
	string "bmlib lib on sophgo platform"
	default n

config BR2_PACKAGE_SOPHGO_BMVID
	string "bmvid lib on sophgo platform"
	default n

config BR2_PACKAGE_SOPHGO_BMCV
	string "bmcv lib on sophgo platform"
	default n

endif

comment "sophgo pakages needs a glibc toolchain w/ C++, threads"
	depends on BR2_aarch64
```
